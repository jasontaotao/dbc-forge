VERSION "minimal-v1"

NS_ :

BS_:

BU_: ECU1

BO_ 256 Msg1: 8 ECU1
SG_ SigA : 0|8@1+ (1,0) [0|255] "" ECU1
SG_ SigB : 8|8@1+ (1,0) [0|255] "" ECU1

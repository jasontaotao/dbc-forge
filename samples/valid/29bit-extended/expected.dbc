VERSION "ext-v1"

NS_ :

BS_:

BU_: Body

BO_ 305441741 DoorMsg: 8 Body
SG_ DoorStatus : 0|4@1+ (1,0) [0|15] "" Body

BO_ 419361024 WindowMsg: 8 Body
SG_ WindowPos : 4|8@1+ (1,0) [0|100] "%" Body

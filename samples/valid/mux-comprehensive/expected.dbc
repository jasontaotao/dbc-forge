VERSION "mux-v1"

NS_ :

BS_:

BU_: Gateway

BO_ 512 MuxMsg: 8 Gateway
SG_ Mux M : 0|4@1+ (1,0) [0|15] "" Gateway
SG_ Mux0Sig m0M : 8|16@1+ (1,0) [0|65535] "rpm" Gateway
SG_ Mux1Sig m1M : 8|16@1- (0.1,-50) [-50|50] "degC" Gateway
SG_ ExtMuxSig M0m0 : 8|16@1+ (1,0) [0|65535] "" Gateway

SG_MUL_VAL_ 512 ExtMuxSig 0 1 ;

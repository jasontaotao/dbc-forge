VERSION "attrs-v1"

NS_ :

BS_:

BU_: BCM

BO_ 768 Lights: 8 BCM
SG_ LightState : 0|8@1+ (1,0) [0|255] "" BCM

BA_DEF_  "BusType" ENUM  "CAN","FlexRay","LIN","MOST";
BA_DEF_DEF_  "BusType" 0;
BA_DEF_  "Baudrate" INT 0 1000000;
BA_DEF_DEF_  "Baudrate" 500000;
BA_DEF_  BO_  "GenMsgCycleTime" INT 0 65535;
BA_DEF_DEF_  "GenMsgCycleTime" 100;
BA_DEF_  BO_  "GenMsgSendType" ENUM  "Cyclic","NotUsed","NotDefined","CyclicAndSpontaneous","CyclicIfActive","Spontaneous","CyclicAndSpontaneousIfActive","CyclicIfActiveAndSpontaneous";
BA_DEF_DEF_  "GenMsgSendType" 0;
BA_DEF_  BO_  "GenMsgStartDelayTime" INT 0 65535;
BA_DEF_DEF_  "GenMsgStartDelayTime" 0;
BA_DEF_  BO_  "GenMsgDelayTime" INT 0 65535;
BA_DEF_DEF_  "GenMsgDelayTime" 0;
BA_DEF_  BO_  "GenMsgNrOfRepetitions" INT 0 65535;
BA_DEF_DEF_  "GenMsgNrOfRepetitions" 0;
BA_DEF_  BO_  "VFrameFormat" ENUM  "StandardCAN","ExtendedCAN","reserved","reserved2","StandardCAN_FD","ExtendedCAN_FD","reserved3","reserved4";
BA_DEF_DEF_  "VFrameFormat" 0;
BA_DEF_  SG_  "GenSigStartValue" FLOAT -1000000000 1000000000;
BA_DEF_DEF_  "GenSigStartValue" 0;
BA_DEF_  SG_  "GenSigInactiveValue" FLOAT -1000000000 1000000000;
BA_DEF_DEF_  "GenSigInactiveValue" 0;
BA_DEF_  SG_  "GenSigTimeoutValue" FLOAT -1000000000 1000000000;
BA_DEF_DEF_  "GenSigTimeoutValue" 0;
